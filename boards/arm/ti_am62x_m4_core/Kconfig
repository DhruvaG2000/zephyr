## boards/arm/ti_am62x_m4_core/Kconfig.board
```kconfig
# TI AM62 sk EVM M4FSS

# SPDX-License-Identifier: Apache-2.0

config BOARD_TI_AM62X_M4_CORE
	bool "TI AM62X_M4_CORE"
#	depends on SOC_SITARA
	select SOC_AM62X_M4_CORE
```

## boards/arm/ti_am62x_m4_core/Kconfig.defconfig
```kconfig
# TI AM62X SK M4 CORE configuration

# SPDX-License-Identifier: Apache-2.0

config BOARD
	default "am62xm4core"
	depends on BOARD_TI_AM62X_M4_CORE
```

## modules/Kconfig.sitara
```kconfig
# CC3220/CC32XX SDK HAL configuration

config HAS_CC3220SDK
	bool

# Notes:
# SimpleLink drivers require types (stdint.h) from c library which is not
# provided by minimal lbc
# Selecting ERRNO lets host driver use Zephyr's __errno
# Selecting PTHREAD_IPC and POSIX_API are needed to build the host driver
config SITARA_HOST_DRIVER
	bool "Build the SimpleLink WiFi Host Driver"
	depends on MULTITHREADING
	select REQUIRES_FULL_LIBC
	select ERRNO
	select PTHREAD_IPC
	select POSIX_CLOCK
	help
	  Build the Sitara host driver

# MSP432 SDK HAL configuration

config HAS_AM62X_M4_CORE_SDK
	bool
	select HAS_CMSIS_CORE

# TI Sitara AM62x SDK HAL configuration (not sure)?

config HAS_CC13X2_CC26X2_SDK
	bool
```

## soc/arm/ti_sitara/Kconfig
```kconfig
# Texas Instruments Sitara Family

# SPDX-License-Identifier: Apache-2.0

config SOC_FAMILY_TISITARA
	bool

if SOC_FAMILY_TISITARA

config SOC_FAMILY
	string
	default "ti_sitara"

source "soc/arm/ti_sitara/*/Kconfig.soc"

config HAS_TI_CCFG
	bool
	help
	  Selected when CCFG (Customer Configuration) registers
	  appear at the end of flash

endif # SOC_FAMILY_TISITARA
```

## soc/arm/ti_sitara/Kconfig.soc
```kconfig
# Texas Instruments Sitara Family

# SPDX-License-Identifier: Apache-2.0

source "soc/arm/ti_sitara/*/Kconfig.series"
```

## soc/arm/ti_sitara/am62x_m4_core/Kconfig.defconfig.am62xm4core
```kconfig
# TI SimpleLink AM62X M4 CORE

# Copyright (c) 2022, Dhruva Gole
# SPDX-License-Identifier: Apache-2.0

if SOC_AM62X_M4_CORE

config SOC
	default "msp432p401r"

config SYS_CLOCK_HW_CYCLES_PER_SEC
	default 48000000

config NUM_IRQS
	default 64

endif # SOC_AM62_M4
```

## soc/arm/ti_sitara/am62x_m4_core/Kconfig.defconfig.series
```kconfig
# TI AM62x M4FSS

# Copyright (c) 2017, Linaro Ltd
# SPDX-License-Identifier: Apache-2.0

if SOC_SERIES_AM62XM4CORE

source "soc/arm/ti_sitara/am62x_m4_core/Kconfig.defconfig.am62xm4core*"

config SOC_SERIES
	default "am62xm4core*"

endif # SOC_SERIES_AM62XM4CORE
```

## soc/arm/ti_sitara/am62x_m4_core/Kconfig.series
```kconfig
# TI AM62x M4FSS
# SPDX-License-Identifier: Apache-2.0

config SOC_SERIES_AM62XM4CORE
	bool "TI AM62X SITARA M4FSS"
	select ARM
	select CPU_CORTEX_M4
	select CPU_CORTEX_M_HAS_DWT
	select DYNAMIC_INTERRUPTS
	help
	  Enable support for TI AM62x M4FSS
```

## soc/arm/ti_sitara/am62x_m4_core/Kconfig.soc
```kconfig
# Texas Instruments Sitara AM62x M4 core

# Copyright (c) 2022, Dhruva Gole
# SPDX-License-Identifier: Apache-2.0

choice
	prompt "TI Sitara M4 Core Selection"
	depends on SOC_SERIES_TISITARA

config SOC_TISITARA
	bool "TISITARA"
	select HAS_AM62X_M4_CORE_SDK
endchoice
```
